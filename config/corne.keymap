// Copyright 2021 Manna Harbour
// https://github.com/manna-harbour/miryoku

#include "../miryoku/custom_config.h"
#include "../miryoku/mapping/42/corne.h"
#include "../miryoku/mapping/42/corne-layouts.dtsi"
#include "../miryoku/miryoku.dtsi"
